## conf/layer.conf
```bitbake
# We have a conf and classes directory, append to BBPATH
BBPATH .= ":${LAYERDIR}"

# We have a recipes directory, add to BBFILES
BBFILES += "${LAYERDIR}/recipes*/*/*.bb ${LAYERDIR}/recipes*/*/*.bbappend"

BBFILE_COLLECTIONS += "iojs-layer"
BBFILE_PATTERN_iojs-layer := "^${LAYERDIR}/"
BBFILE_PRIORITY_iojs-layer = "47"
```
